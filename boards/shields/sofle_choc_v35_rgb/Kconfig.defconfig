## boards/shields/sofle_choc_v35_rgb/Kconfig.shield
```kconfig
# Copyright (c) 2026
# SPDX-License-Identifier: MIT

config SHIELD_SOFLE_CHOC_V35_RGB
    def_bool $(shields_list_contains,sofle_choc_v35_rgb)
```

## config/west.yml
```yaml
manifest:
  defaults:
    revision: v0.3

  remotes:
    - name: zmkfirmware
      url-base: https://github.com/zmkfirmware
    - name: urob
      url-base: https://github.com/urob

  projects:
    - name: zmk
      remote: zmkfirmware
      import: app/west.yml
    - name: zmk-unicode
      remote: urob
      revision: v0.3 # keep in sync with the ZMK revision above

  self:
    path: config
```

## dts/bindings/behaviors/zmk,behavior-sofle-rgb-profile.yaml
```yaml
# SPDX-License-Identifier: MIT

description: Synchronize a Sofle RGB settings slot across both halves

compatible: "zmk,behavior-sofle-rgb-profile"

include: two_param.yaml
```
