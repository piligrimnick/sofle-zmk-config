/*
 * Sofle Choc V3.5 per-key RGB add-on.
 *
 * The controller-specific pin setup lives in boards/nice_nano_v2.overlay.
 * This shield intentionally does not define any separate underglow LEDs.
 *
 * SPDX-License-Identifier: MIT
 */

#include <zephyr/dt-bindings/gpio/gpio.h>

/* The replacement EC11 on the left half turns the other way. Swap its A/B
 * pins relative to the upstream sofle.dtsi so the keymap keeps meaning
 * "first binding = clockwise" on both halves. */
&left_encoder {
    a-gpios = <&pro_micro 20 (GPIO_ACTIVE_HIGH | GPIO_PULL_UP)>;
    b-gpios = <&pro_micro 21 (GPIO_ACTIVE_HIGH | GPIO_PULL_UP)>;
};

/ {
    behaviors {
        /* Internal global behavior used to tell both halves which of the five
         * Bluetooth-specific RGB slots is active. The short node name also
         * fits the ZMK split behavior protocol. */
        rgb_prof: rgb_prof {
            compatible = "zmk,behavior-sofle-rgb-profile";
            #binding-cells = <2>;
        };
    };
};
